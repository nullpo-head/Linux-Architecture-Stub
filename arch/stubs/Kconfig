## arch/stubs/Kconfig
```kconfig
config STUBS
	def_bool y
	select GENERIC_IRQ_SHOW
	select GENERIC_IRQ_PROBE
	select GENERIC_IOMAP
	select GENERIC_ATOMIC64
	select GENERIC_CPU_DEVICES
	select GENERIC_CLOCKEVENTS
	select HAVE_MEMBLOCK
	select ARCH_DISCARD_MEMBLOCK
	select MODULES_USE_ELF_REL

config RWSEM_GENERIC_SPINLOCK
	def_bool y

config GENERIC_HWEIGHT
	def_bool y

config GENERIC_CALIBRATE_DELAY
	def_bool y

config NO_DMA
	def_bool y

config NO_IOMEM
	def_bool y

source "mm/Kconfig"

source "kernel/Kconfig.hz"
source "kernel/Kconfig.preempt"

config RWSEM_GENERIC_SPINLOCK
	def_bool y

config LOCKDEP_SUPPORT
	def_bool y

config STACKTRACE_SUPPORT
	def_bool y

config GENERIC_CSUM
	def_bool y

config NR_CPUS
	int
	default "1"

source "init/Kconfig"

source "kernel/Kconfig.freezer"

config MMU
def_bool y

menu "Executable file formats"

source "fs/Kconfig.binfmt"

endmenu

source "net/Kconfig"

source "drivers/Kconfig"

source "fs/Kconfig"

source "security/Kconfig"

source "crypto/Kconfig"

source "lib/Kconfig"

menu "Kernel hacking"

source "lib/Kconfig.debug"

endmenu
```
